TBF_HEADER_SIZE = 0x60;

/* FLASH_START  = 0x00080000; */
/* FLASH_LENGTH = 0x00010000; */
/* RAM_START    = 0x40080000; */
/* RAM_LENGTH   = 0x00010000; */

/* FLASH_START  = 0x80100000; */
/* FLASH_LENGTH = 0x00100000; */
/* RAM_START    = 0x80300000; */
/* RAM_LENGTH   = 0x00100000; */

/* FLASH_START  = 0x200a0000; */
/* FLASH_LENGTH = 0x00010000; */
/* RAM_START    = 0x10018000; */
/* RAM_LENGTH   = 0x00008000; */

FLASH_START  = 0x00040000;
FLASH_LENGTH = 0x00010000;
RAM_START    = 0x20020000;
RAM_LENGTH   = 0x00010000;


INCLUDE ../../encapfn-rt/encapfn_layout.ld
